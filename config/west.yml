## config/west.yml
```yaml
manifest:
  remotes:
    - name: zmkfirmware
      # url-base: https://github.com/zmkfirmware
      url-base: https://github.com/infused-kim
  projects:
    - name: zmk
      # remote: zmkfirmware
      # revision: main
      remote: zmkfirmware
      revision: my-changes/split-encoder
      import: app/west.yml
  self:
    path: config
```
